## dts/bindings/ethernet/snps,designware-ethernet.yaml
```yaml
# Copyright (c) 2021, BayLibre SAS
# SPDX-License-Identifier: Apache-2.0

description: Synopsys DesignWare Ethernet

compatible: "snps,designware-ethernet"

include: ethernet-controller.yaml

properties:
  reg:
    required: true
  interrupts:
    required: true
  eth_mdio:
    type: phandle
    description: |
      Phandle to the MDIO controller for managing PHY
      configuration and link setup.
```

## dts/bindings/mdio/alif,mdio.yaml
```yaml
# Copyright (C) 2025 Alif Semiconductor
# SPDX-License-Identifier: Apache-2.0

description: Alif MDIO Features

compatible: "alif,mdio"

include: [mdio-controller.yaml, pinctrl-device.yaml]

properties:
  pinctrl-0:
    required: true

  pinctrl-names:
    required: true
```
